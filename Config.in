## configs/rpi4_64_router_defconfig
```kconfig
BR2_aarch64=y
BR2_cortex_a72=y
BR2_ARM_FPU_VFPV4=y
BR2_CCACHE=y
BR2_TOOLCHAIN_EXTERNAL=y
BR2_ROOTFS_DEVICE_CREATION_DYNAMIC_MDEV=y
BR2_ROOTFS_DEVICE_TABLE="system/device_table.txt $(BR2_EXTERNAL_JOELSONCARL_PATH)/board/rpi4_64_router/rootfs_overlay_permissions.txt"
BR2_TARGET_GENERIC_ROOT_PASSWD="CHANGE_ME_ROOT_PW99"
BR2_ENABLE_LOCALE_WHITELIST="en_US.UTF-8"
BR2_GENERATE_LOCALE="en_US.UTF-8"
BR2_ROOTFS_OVERLAY="$(BR2_EXTERNAL_JOELSONCARL_PATH)/board/rpi4_64_router/rootfs_overlay"
BR2_ROOTFS_POST_BUILD_SCRIPT="board/raspberrypi4-64/post-build.sh $(BR2_EXTERNAL_JOELSONCARL_PATH)/board/rpi4_64_router/post_build.sh"
BR2_ROOTFS_POST_IMAGE_SCRIPT="board/raspberrypi4-64/post-image.sh"
BR2_ROOTFS_POST_SCRIPT_ARGS="--add-miniuart-bt-overlay --aarch64"
BR2_LINUX_KERNEL=y
BR2_LINUX_KERNEL_CUSTOM_TARBALL=y
BR2_LINUX_KERNEL_CUSTOM_TARBALL_LOCATION="$(call github,raspberrypi,linux,1c64f4bc22811d2d371b271daa3fb27895a8abdd)/linux-1c64f4bc22811d2d371b271daa3fb27895a8abdd.tar.gz"
BR2_LINUX_KERNEL_DEFCONFIG="bcm2711"
BR2_LINUX_KERNEL_DTS_SUPPORT=y
BR2_LINUX_KERNEL_INTREE_DTS_NAME="broadcom/bcm2711-rpi-4-b"
BR2_LINUX_KERNEL_NEEDS_HOST_OPENSSL=y
BR2_PACKAGE_BUSYBOX_CONFIG_FRAGMENT_FILES="$(BR2_EXTERNAL_JOELSONCARL_PATH)/board/rpi4_64_router/busybox_conf.frag"
BR2_PACKAGE_BUSYBOX_SHOW_OTHERS=y
BR2_PACKAGE_LSOF=y
BR2_PACKAGE_LTRACE=y
BR2_PACKAGE_STRACE=y
BR2_PACKAGE_RPI_FIRMWARE=y
BR2_PACKAGE_RPI_FIRMWARE_VARIANT_PI4=y
BR2_PACKAGE_RPI_WIFI_FIRMWARE=y
BR2_PACKAGE_RNG_TOOLS=y
BR2_PACKAGE_LIBTIRPC=y
BR2_PACKAGE_BRIDGE_UTILS=y
BR2_PACKAGE_CONNTRACK_TOOLS=y
BR2_PACKAGE_DHCP=y
BR2_PACKAGE_DHCP_CLIENT=y
BR2_PACKAGE_DHCPDUMP=y
BR2_PACKAGE_DNSMASQ=y
BR2_PACKAGE_DNSMASQ_DNSSEC=y
BR2_PACKAGE_DNSMASQ_CONNTRACK=y
BR2_PACKAGE_HOSTAPD=y
BR2_PACKAGE_HOSTAPD_WPA3=y
BR2_PACKAGE_IFUPDOWN=y
BR2_PACKAGE_IPROUTE2=y
BR2_PACKAGE_IPTABLES=y
BR2_PACKAGE_IW=y
BR2_PACKAGE_OPENSSH=y
BR2_PACKAGE_OPENVPN=y
BR2_PACKAGE_RSYNC=y
BR2_PACKAGE_TCPDUMP=y
BR2_PACKAGE_TRACEROUTE=y
BR2_PACKAGE_WIRELESS_REGDB=y
BR2_PACKAGE_WIRELESS_TOOLS=y
BR2_PACKAGE_WPA_SUPPLICANT=y
BR2_PACKAGE_WPA_SUPPLICANT_AUTOSCAN=y
BR2_PACKAGE_WPA_SUPPLICANT_DEBUG_SYSLOG=y
BR2_PACKAGE_WPA_SUPPLICANT_WPA3=y
BR2_PACKAGE_WPA_SUPPLICANT_CLI=y
BR2_PACKAGE_WPA_SUPPLICANT_WPA_CLIENT_SO=y
BR2_PACKAGE_WPA_SUPPLICANT_PASSPHRASE=y
BR2_PACKAGE_TMUX=y
BR2_PACKAGE_SYSKLOGD=y
BR2_TARGET_ROOTFS_EXT2=y
BR2_TARGET_ROOTFS_EXT2_4=y
BR2_TARGET_ROOTFS_EXT2_SIZE="200M"
# BR2_TARGET_ROOTFS_TAR is not set
BR2_PACKAGE_HOST_DOSFSTOOLS=y
BR2_PACKAGE_HOST_GENIMAGE=y
BR2_PACKAGE_HOST_MTOOLS=y
```

## package/dnsmasq-blocklists/Config.in
```kconfig
comment "dnsmasq blocklists requires dnsmasq"
	depends on !BR2_PACKAGE_DNSMASQ

config BR2_PACKAGE_DNSMASQ_BLOCKLISTS
	bool "Install blocklists for dnsmasq"
	depends on BR2_PACKAGE_DNSMASQ
	help
	  Install blocklists for dnsmasq

if BR2_PACKAGE_DNSMASQ_BLOCKLISTS

config BR2_PACKAGE_DNSMASQ_BLOCKLISTS_INSTALL_DIR
	string "Target install directory"
	default "/etc/dnsmasq.d"
	help
	  Where blocklists will get installed on the target. Make sure
	  your system's dnsmasq.conf has a configuration option of
	  'conf-dir=<directory>' that matches this setting for the
	  blocklists to be used. Default "/etc/dnsmasq.d"

comment "StevenBlack Hosts requires BusyBox or systemV init, curl"
	depends on !BR2_INIT_BUSYBOX && !BR2_INIT_SYSV || \
		!BR2_PACKAGE_LIBCURL_CURL

config BR2_PACKAGE_DNSMASQ_BLOCKLISTS_STEVEN_BLACK_HOSTS_DYNAMIC
	bool "Dynamic StevenBlack Unified hosts list"
	depends on BR2_INIT_BUSYBOX || BR2_INIT_SYSV
	depends on BR2_PACKAGE_LIBCURL_CURL
	help
	  The Unified hosts (adware + malware) list from StevenBlack/hosts
	  on github. An init script will be installed that during boot will
	  grab the latest version from github.

	  https://github.com/StevenBlack/hosts

if BR2_PACKAGE_DNSMASQ_BLOCKLISTS_STEVEN_BLACK_HOSTS_DYNAMIC
config BR2_PACKAGE_DNSMASQ_BLOCKLISTS_STEVEN_BLACK_HOSTS_DYNAMIC_INIT_NUM
	string "Init script number"
	default "79"
	help
	  Which init script number to use when installing the script.
	  Default is 79, as the default dnsmasq init script installed by
	  the dnsmasq package is 80.
endif

endif
```

## package/noip-duc/Config.in
```kconfig
comment "No-IP DUC requires BusyBox or systemV init"
	depends on !BR2_INIT_BUSYBOX && !BR2_INIT_SYSV

config BR2_PACKAGE_NOIP_DUC
	bool "No-IP DUC"
	depends on BR2_INIT_BUSYBOX || BR2_INIT_SYSV
	help
	  Installs the No-IP Dynamic Update Client (DUC)

if BR2_PACKAGE_NOIP_DUC

config BR2_PACKAGE_NOIP_DUC_INIT_NUM
	string "Init script number"
	default "90"
	help
	  Which init script number to use when installing the startup
	  script. Default is 90.

endif
```
